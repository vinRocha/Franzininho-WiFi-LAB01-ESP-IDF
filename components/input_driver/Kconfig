## components/input_driver/Kconfig
```kconfig
menu "Input Driver"

    config INPUT_TASK_PRIORITY
        int "Input Driver Task Priority"
        default 11

    config INPUT_TASK_STACK_SIZE
        int "Input Driver Task Stack Size in words"
        default 2056

endmenu
```

## components/ldr_driver/Kconfig
```kconfig
menu "LDR Driver"

    config LDR_TASK_PRIORITY
        int "LDR Task Priority"
        default 4

    config LDR_TASK_STACK_SIZE
        int "LDR Task Stack Size in words"
        default 2056

endmenu
```

## components/ledc_buzzer_driver/Kconfig
```kconfig
menu "LEDC Buzzer Driver"

    config LEDC_BUZZER_GPIO
        int "LEDC Buzzer GPIO"
        default 17

    config LEDC_BUZZER_FREQ_DEFAULT
        int "LEDC Buzzer default frequency (Hz)"
        default 523

    config LEDC_BUZZER_TASK_PRIORITY
        int "LEDC Buzzer Task Priority"
        default 3

    config LEDC_BUZZER_TASK_STACK_SIZE
        int "LEDC Buzzer Task Stack Size in words"
        default 2048

endmenu
```

## components/rgb_led_driver/Kconfig
```kconfig
menu "RGB LED Driver"

    config RGB_LED_R_GPIO
        int "Red LED GPIO"
        default 14

    config RGB_LED_G_GPIO
        int "Green LED GPIO"
        default 13

    config RGB_LED_B_GPIO
        int "Blue LED GPIO"
        default 12

endmenu
```
